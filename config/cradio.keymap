/* source keypos definitions */
#include "../zmk-nodefree-config/keypos_def/keypos_34keys.h"

// ARTS Row
#define KEY_A RM1
#define KEY_R RM2
#define KEY_T RM3
#define KEY_S RM4
// EYIO Row
#define KEY_E RB1
#define KEY_Y RB2
#define KEY_I RB3
#define KEY_O RB4

// Define Offsets
#define LEADING_NONES NONE(0,1,6)
#define MIDDLE_NONES NONE(0,0,6)
#define TRAILING_NONES NONE(0,0,4)

/* source the main keymap */
#include "base.keymap"
