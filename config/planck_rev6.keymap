/* source keypos definitions */
#include "../zmk-nodefree-config/keypos_def/keypos_48keys_wide.h"

/* map Planck's extra keys */
#define EXTRA_MID   &none            &none              // 3x2 middle keys
#define EXTRA_BOT_L &none            &kp LGUI  &none    // 1x2 bottom left keys
#define EXTRA_BOT_R &none            &none              // 1x2 bottom right keys

// ARTS Row
#define KEY_A RM1
#define KEY_R RM2
#define KEY_T RM3
#define KEY_S RM4
// EYIO Row
#define KEY_E RB1
#define KEY_Y RB2
#define KEY_I RB3
#define KEY_O RB4

// Define Offsets
#define LEADING_NONES NONE(0,2,0)
#define MIDDLE_NONES NONE(0,0,8)
#define TRAILING_NONES NONE(0,1,2)

/* source the main keymap */
#include "base.keymap"
