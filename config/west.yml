## config/west.yml
```yaml
manifest:
  remotes:
    - name: dpangier
      url-base: https://github.com/dpangier
  projects:
    - name: zmk
      remote: dpangier
      revision: main
      import: app/west.yml
  self:
    path: config
```
